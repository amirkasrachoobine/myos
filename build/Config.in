## build/Config.in
```kconfig
menu "myos packages"

source "$BR2_EXTERNAL_MYOS_PATH/package/myos-hello-rust/Config.in"
source "$BR2_EXTERNAL_MYOS_PATH/package/myos-hello-cpp/Config.in"
source "$BR2_EXTERNAL_MYOS_PATH/package/myos-init/Config.in"

source "$BR2_EXTERNAL_MYOS_PATH/package/myos-bus/Config.in"
source "$BR2_EXTERNAL_MYOS_PATH/package/myos-bus-cpp/Config.in"
source "$BR2_EXTERNAL_MYOS_PATH/package/myos-bus-python/Config.in"
source "$BR2_EXTERNAL_MYOS_PATH/package/myos-bus-java/Config.in"

source "$BR2_EXTERNAL_MYOS_PATH/package/myos-services/Config.in"

source "$BR2_EXTERNAL_MYOS_PATH/package/myos-msh/Config.in"
source "$BR2_EXTERNAL_MYOS_PATH/package/myos-utils/Config.in"

source "$BR2_EXTERNAL_MYOS_PATH/package/myos-admin/Config.in"

source "$BR2_EXTERNAL_MYOS_PATH/package/myos-java/Config.in"
endmenu
```

## build/package/myos-admin/Config.in
```kconfig
config BR2_PACKAGE_MYOS_ADMIN
	bool "myos-admin"
	depends on BR2_PACKAGE_MYOS_BUS_PYTHON
	select BR2_PACKAGE_E2FSPROGS # mkfs.ext4, for myos-install
	help
	  The myos admin tools (Phase 5), in Python:

	    myctl         services (through init), logs (from logd) and
	                  settings: hostname, network, enabled services
	    myos-install  install the running system onto a disk with an
	                  MBR, an ext4 root and GRUB, ready to boot

	  myos-install needs GRUB for BIOS (BR2_TARGET_GRUB2_I386_PC),
	  whose boot.img and core image this package copies to
	  /usr/lib/myos/boot, and the kernel in /boot
	  (BR2_LINUX_KERNEL_INSTALL_TARGET).

comment "myos-admin needs myos-bus-python"
	depends on !BR2_PACKAGE_MYOS_BUS_PYTHON
```

## build/package/myos-bus-cpp/Config.in
```kconfig
config BR2_PACKAGE_MYOS_BUS_CPP
	bool "myos-bus-cpp"
	depends on BR2_INSTALL_LIBSTDCPP
	depends on BR2_TOOLCHAIN_HAS_THREADS
	depends on BR2_PACKAGE_PROTOBUF_ARCH_SUPPORTS
	depends on BR2_TOOLCHAIN_GCC_AT_LEAST_8
	depends on !BR2_STATIC_LIBS
	select BR2_PACKAGE_PROTOBUF
	help
	  C++ client library for the myos IPC bus, and the
	  myos-bus-ping-cpp test client. libmyosbus, its headers and
	  myos-bus.pc go to staging for the Phase 4 tools.

comment "myos-bus-cpp needs a toolchain w/ C++, threads, dynamic library, gcc >= 8"
	depends on BR2_PACKAGE_PROTOBUF_ARCH_SUPPORTS
	depends on !BR2_INSTALL_LIBSTDCPP || !BR2_TOOLCHAIN_HAS_THREADS \
		|| BR2_STATIC_LIBS || !BR2_TOOLCHAIN_GCC_AT_LEAST_8
```

## build/package/myos-bus-java/Config.in
```kconfig
config BR2_PACKAGE_MYOS_BUS_JAVA
	bool "myos-bus-java"
	depends on BR2_PACKAGE_OPENJDK
	depends on BR2_PACKAGE_HOST_PROTOBUF_ARCH_SUPPORTS
	help
	  Java client for the myos IPC bus (package org.myos.bus, in
	  /usr/share/java/myos-bus.jar) and the myos-bus-ping-java
	  test client. protobuf-java is compiled from the protobuf
	  source Buildroot already fetches for host-protobuf, so it
	  always matches protoc.

comment "myos-bus-java needs OpenJDK (make WITH_JAVA=1)"
	depends on !BR2_PACKAGE_OPENJDK
```

## build/package/myos-bus-python/Config.in
```kconfig
config BR2_PACKAGE_MYOS_BUS_PYTHON
	bool "myos-bus-python"
	depends on BR2_PACKAGE_PYTHON3
	depends on BR2_PACKAGE_HOST_PROTOBUF_ARCH_SUPPORTS
	select BR2_PACKAGE_PYTHON_PROTOBUF
	help
	  Python client for the myos IPC bus (the myos.bus module) and
	  the myos-bus-ping-py test client.
```

## build/package/myos-bus/Config.in
```kconfig
config BR2_PACKAGE_MYOS_BUS
	bool "myos-bus"
	depends on BR2_PACKAGE_HOST_RUSTC_TARGET_ARCH_SUPPORTS
	depends on BR2_PACKAGE_HOST_PROTOBUF_ARCH_SUPPORTS
	select BR2_PACKAGE_HOST_RUSTC
	help
	  The myos IPC bus (Phase 2): the busd broker, listening on
	  /run/myos/bus.sock, and the myos-bus command-line client
	  (myos-bus ping, myos-bus list). Started by init from
	  /etc/myos/services/busd.toml.
```

## build/package/myos-hello-cpp/Config.in
```kconfig
config BR2_PACKAGE_MYOS_HELLO_CPP
	bool "myos-hello-cpp"
	depends on BR2_INSTALL_LIBSTDCPP
	help
	  Phase 0 smoke test for the C++ cross toolchain. The Phase 4
	  shell (msh) and utilities will be packaged the same way.

comment "myos-hello-cpp needs a toolchain w/ C++"
	depends on !BR2_INSTALL_LIBSTDCPP
```

## build/package/myos-hello-rust/Config.in
```kconfig
config BR2_PACKAGE_MYOS_HELLO_RUST
	bool "myos-hello-rust"
	depends on BR2_PACKAGE_HOST_RUSTC_TARGET_ARCH_SUPPORTS
	select BR2_PACKAGE_HOST_RUSTC
	help
	  Phase 0 smoke test for the Rust cross toolchain. The Phase 1
	  init (PID 1) will be packaged the same way.
```

## build/package/myos-init/Config.in
```kconfig
config BR2_PACKAGE_MYOS_INIT
	bool "myos-init"
	depends on BR2_PACKAGE_HOST_RUSTC_TARGET_ARCH_SUPPORTS
	depends on BR2_INIT_NONE
	select BR2_PACKAGE_HOST_RUSTC
	help
	  The myos PID 1, written in Rust (rust/init). Installed as
	  /usr/bin/myos-init with /sbin/init and /usr/bin/initctl
	  symlinks. Services are TOML files in /etc/myos/services/.

comment "myos-init needs System configuration -> Init system -> None"
	depends on !BR2_INIT_NONE
```

## build/package/myos-java/Config.in
```kconfig
config BR2_PACKAGE_MYOS_JAVA
	bool "myos-java"
	depends on BR2_PACKAGE_OPENJDK
	depends on BR2_PACKAGE_HOST_PROTOBUF_ARCH_SUPPORTS # myos-bus-java
	depends on BR2_PACKAGE_HOST_RUSTC_TARGET_ARCH_SUPPORTS # jrun, in myos-services
	select BR2_PACKAGE_OPENJDK_FULL_JDK # its jmods, for jlink
	select BR2_PACKAGE_MYOS_BUS_JAVA
	select BR2_PACKAGE_MYOS_SERVICES # jrun
	help
	  The Java app runtime (Phase 6):
	    /usr/lib/myos/jdk            a JDK trimmed with jlink to the
	                                 modules apps need (~40 MB)
	    /usr/share/java/myos-sdk.jar the app SDK (org.myos.sdk) and
	                                 the launcher jrun starts
	  jrun itself (/usr/bin/jrun) is built with myos-services.
	  The full OpenJDK is built only for its jmods and is removed
	  from the target unless you keep it below.

if BR2_PACKAGE_MYOS_JAVA

config BR2_PACKAGE_MYOS_JAVA_MODULES
	string "JDK modules for apps"
	default "java.base,java.logging,jdk.unsupported,java.net.http,jdk.crypto.ec"
	help
	  The modules jlink puts in /usr/lib/myos/jdk. The SDK needs
	  java.base, java.logging and jdk.unsupported (protobuf-java)
	  and java.net.http (Net.http()).

config BR2_PACKAGE_MYOS_JAVA_SAMPLE_APP
	bool "sample app (org.myos.hello)"
	default y
	help
	  /usr/share/myos/apps/org.myos.hello.mapp. Install it with
	  jrun install /usr/share/myos/apps/org.myos.hello.mapp

config BR2_PACKAGE_MYOS_JAVA_KEEP_FULL_JDK
	bool "keep the full JDK in /usr/lib/jvm"
	help
	  Normally removed: apps get the trimmed one. Keep it for
	  javac, jshell, jcmd and the rest on the target (~300 MB).

endif

comment "myos-java needs OpenJDK"
	depends on !BR2_PACKAGE_OPENJDK
```

## build/package/myos-msh/Config.in
```kconfig
config BR2_PACKAGE_MYOS_MSH
	bool "myos-msh"
	depends on BR2_INSTALL_LIBSTDCPP
	depends on BR2_USE_MMU # fork()
	help
	  msh, the myos shell (Phase 4): pipes, redirections, job
	  control, history, Tab completion, if/for/while, functions.
	  Installs /usr/bin/msh and /etc/mshrc.

if BR2_PACKAGE_MYOS_MSH

config BR2_PACKAGE_MYOS_MSH_LOGIN_SHELL
	bool "make msh root's login shell"
	default y
	help
	  Sets root's shell in /etc/passwd to /usr/bin/msh and adds it
	  to /etc/shells. /bin/sh stays BusyBox ash, for scripts.

endif

comment "myos-msh needs a toolchain w/ C++"
	depends on BR2_USE_MMU
	depends on !BR2_INSTALL_LIBSTDCPP
```

## build/package/myos-services/Config.in
```kconfig
config BR2_PACKAGE_MYOS_SERVICES
	bool "myos-services"
	depends on BR2_PACKAGE_HOST_RUSTC_TARGET_ARCH_SUPPORTS
	depends on BR2_PACKAGE_HOST_PROTOBUF_ARCH_SUPPORTS
	select BR2_PACKAGE_HOST_RUSTC
	select BR2_PACKAGE_MYOS_BUS # runtime: they serve on the bus
	help
	  The myos core services (Phase 3), started by init from
	  /etc/myos/services/:
	    logd      log daemon: /dev/log, kernel messages and
	              every service's output; /var/log/messages
	    netd      network: lo, DHCP or static addresses from
	              /etc/myos/netd.toml, resolv.conf
	    sysinfod  CPU, memory, disk and process information
	  and their command-line tools myos-log, myos-net and
	  myos-sysinfo. Also jrun, which installs and runs the
	  Phase 6 Java apps (see myos-java).
```

## build/package/myos-utils/Config.in
```kconfig
config BR2_PACKAGE_MYOS_UTILS
	bool "myos-utils"
	depends on BR2_PACKAGE_MYOS_BUS_CPP
	help
	  ls, cat, ps and top in C++ (Phase 4). They replace BusyBox's
	  applets of the same names (/bin/ls, /bin/cat, /bin/ps,
	  /usr/bin/top); `busybox ps` and so on still work. ps and top
	  read their data from sysinfod over the bus.

comment "myos-utils needs myos-bus-cpp"
	depends on !BR2_PACKAGE_MYOS_BUS_CPP
```
